/** 
 * @file     lcd.c
 * @brief    COG12864液晶屏显示
 * @details  ST7565R驱动
 * @author   华兄
 * @email    591881218@qq.com
 * @date     2014
 * @version  vX.XX
 * @par Copyright (c):  
 *           深圳市合尔凯科技有限公司
 * @par History:          
 *   version: author, date, desc\n 
 */

#include "includes.h"


const unsigned char lcd_map_welcome[] =
{
    /*-- 宽度x高度=128x64 --*/
    0x00,0x00,0x00,0x00,0x00,0x00,0x00,0x00,0x00,0x00,0x00,0x00,0x00,0x00,0x00,0x00,
    0x00,0x00,0x00,0x00,0x00,0x00,0x80,0x80,0x80,0xC0,0xC0,0xE0,0xE0,0xE0,0xF0,0xF0,
    0xF8,0xF8,0xF8,0xFC,0xFC,0xFE,0xFE,0xFE,0xFC,0xF8,0xE0,0x80,0x00,0x00,0x00,0x00,
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    0x00,0x00,0x00,0x00,0x00,0x00,0x00,0x00,0x00,0x00,0x00,0x00,0x00,0x00,0x00,0x00,
};

unsigned char lcd_disp_buf[LCD_YSIZE / 8][LCD_XSIZE];

void lcd_delay(unsigned long dly)
{
    OSTimeDly(dly);
}

void lcd_send_byte(unsigned char byte)
{
    unsigned char i, temp;


    temp = byte;

    for(i = 0; i < 8; i++)
    {
        LCD_SCK_LOW();

        if(temp & 0x80)
        {
            LCD_MOSI_HIGH();
        }
        else
        {
            LCD_MOSI_LOW();
        }

        LCD_SCK_HIGH();

        temp <<= 1;
    }
}

void lcd_write_cmd(unsigned char cmd)
{   
    OS_CPU_SR_ALLOC();
    

    OS_ENTER_CRITICAL();
    
    LCD_RS_LOW();
    LCD_CS_LOW();
    lcd_send_byte(cmd);
    LCD_CS_HIGH();

    OS_EXIT_CRITICAL();
}

void lcd_write_data(unsigned char data)
{	
    OS_CPU_SR_ALLOC();
    

    OS_ENTER_CRITICAL();
    
    LCD_RS_HIGH();
    LCD_CS_LOW();
    lcd_send_byte(data);
    LCD_CS_HIGH();

    OS_EXIT_CRITICAL();
}

void lcd_clr_scr(void)
{
    unsigned char page, seg;

    
    for(page = 0xb0; page < 0xb8; page++)
    {
        lcd_write_cmd(page); //page
       
        lcd_write_cmd(0x10); //column
        
        lcd_write_cmd(0x00); //column

        for(seg = 0; seg < 128; seg++) //写128列
        {
            lcd_write_data(0x00);	
        }	
    }
}

void lcd_disp_map(unsigned char *map)
{
    unsigned char page, seg;

    
    for(page = 0xb0; page < 0xb8; page++)
    {
        lcd_write_cmd(page); //page
       
        lcd_write_cmd(0x10); //column
        
        lcd_write_cmd(0x00); //column

        for(seg = 0; seg < 128; seg++) //写128列
        {
            lcd_write_data(*map++);	
        }	
    }
}

void lcd_init(void)
{    
    LCD_Config();

    LCD_BACKLIGHT_OFF();    

    lcd_delay(2);

    LCD_RST_LOW();
    lcd_delay(2);
    LCD_RST_HIGH();
    lcd_delay(2);

    lcd_write_cmd(0xe2); /*软复位*/
    lcd_delay(2);
    lcd_write_cmd(0x2c); /*升压步聚1*/
    lcd_delay(2);
    lcd_write_cmd(0x2e); /*升压步聚2*/
    lcd_delay(2);
    lcd_write_cmd(0x2f); /*升压步聚3*/
    lcd_delay(2);
    lcd_write_cmd(0x25); /*粗调对比度，可设置范围0x20～0x27*/
    lcd_write_cmd(0x81); /*微调对比度*/
    lcd_write_cmd(0x16); /*微调对比度的值，可设置范围0x00～0x3f*/
    lcd_write_cmd(0xa2); /*1/9 偏压比（bias）*/
    lcd_write_cmd(0xc8); /*行扫描顺序：从上到下*/
    lcd_write_cmd(0xa0); /*列扫描顺序：从左到右*/ 
    lcd_write_cmd(0x40); /*起始行：从第一行开始*/
    lcd_write_cmd(0xaf); /*开显示*/

    lcd_delay(2);

    lcd_clr_scr();
}

